## configs/spacemit_k1_benchmark_defconfig
```kconfig
BR2_riscv=y
BR2_TOOLCHAIN_EXTERNAL=y
BR2_TOOLCHAIN_EXTERNAL_CUSTOM=y
BR2_TOOLCHAIN_EXTERNAL_PATH=""
BR2_TOOLCHAIN_EXTERNAL_CUSTOM_PREFIX="$(ARCH)-unknown-linux-gnu"
BR2_TOOLCHAIN_EXTERNAL_HEADERS_5_10=y
BR2_TOOLCHAIN_EXTERNAL_CUSTOM_GLIBC=y
# BR2_TOOLCHAIN_EXTERNAL_INET_RPC is not set
BR2_TOOLCHAIN_EXTERNAL_CXX=y
BR2_SYSTEM_DHCP="eth0"
BR2_ROOTFS_OVERLAY="board/visionfive2/overlay"
BR2_ROOTFS_POST_IMAGE_SCRIPT="support/scripts/genimage.sh"
BR2_ROOTFS_POST_SCRIPT_ARGS="-c board/visionfive/genimage.cfg"
BR2_PACKAGE_COREMARK=y
BR2_PACKAGE_COREMARK_PRO=y
BR2_PACKAGE_DHRYSTONE=y
BR2_PACKAGE_FIO=y
BR2_PACKAGE_IOZONE=y
BR2_PACKAGE_LATENCYTOP=y
BR2_PACKAGE_LMBENCH=y
BR2_PACKAGE_LTP_TESTSUITE=y
BR2_PACKAGE_MBW=y
BR2_PACKAGE_MEMSTAT=y
BR2_PACKAGE_NETPERF=y
BR2_PACKAGE_RAMSMP=y
BR2_PACKAGE_RAMSPEED=y
BR2_PACKAGE_STRESS_NG=y
BR2_PACKAGE_TINYMEMBENCH=y
BR2_PACKAGE_WHETSTONE=y
BR2_PACKAGE_LINPACK=y
BR2_PACKAGE_STREAM=y
BR2_PACKAGE_CSMITH=y
BR2_PACKAGE_POSTMARK=y
BR2_PACKAGE_FHOURSTONES88=y
BR2_PACKAGE_BLOGBENCH=y
BR2_PACKAGE_TACHYON=y
BR2_PACKAGE_SWETEST=y
BR2_PACKAGE_SCIMARK2=y
BR2_PACKAGE_MAFFT=y
BR2_PACKAGE_CLOMP=y
BR2_PACKAGE_LZBENCH=y
BR2_PACKAGE_CRAY=y
BR2_PACKAGE_HIMENO=y
BR2_PACKAGE_SMALLPT=y
BR2_PACKAGE_FSMARK=y
BR2_PACKAGE_TIOBENCH=y
BR2_PACKAGE_DCRAW=y
BR2_PACKAGE_AOBENCH=y
BR2_PACKAGE_M_QUEENS=y
BR2_PACKAGE_TSCP=y
BR2_PACKAGE_STOCKFISH=y
BR2_PACKAGE_NBENCH=y
BR2_PACKAGE_MIBENCH=y
BR2_PACKAGE_AOM_AV1_PSY=y
BR2_PACKAGE_PRIMESIEVE=y
BR2_PACKAGE_TELEBENCH=y
BR2_PACKAGE_OABENCHV2=y
BR2_PACKAGE_XSBENCH=y
BR2_PACKAGE_GRAPHICSMAGICK=y
BR2_PACKAGE_MEMTESTER=y
BR2_PACKAGE_MBEDTLS=y
BR2_PACKAGE_MBEDTLS_PROGRAMS=y
BR2_PACKAGE_MBEDTLS_COMPRESSION=y
BR2_PACKAGE_MBEDTLS_DTLS_SRTP=y
BR2_PACKAGE_OPENSSL=y
BR2_PACKAGE_WOLFSSL=y
BR2_PACKAGE_WOLFSSL_ALL=y
BR2_PACKAGE_WOLFSSL_SSLV3=y
BR2_PACKAGE_LIBPNG=y
BR2_PACKAGE_OPENCV3=y
BR2_PACKAGE_OPENCV3_LIB_OBJDETECT=y
BR2_PACKAGE_OPENCV3_LIB_SHAPE=y
BR2_PACKAGE_OPENCV3_LIB_VIDEOIO=y
BR2_PACKAGE_OPENCV3_LIB_VIDEOSTAB=y
BR2_PACKAGE_OPENCV3_BUILD_TESTS=y
BR2_PACKAGE_OPENCV3_BUILD_PERF_TESTS=y
BR2_PACKAGE_OPENCV3_WITH_FFMPEG=y
BR2_PACKAGE_LIBOGG=y
BR2_PACKAGE_FFTW=y
BR2_PACKAGE_PROTOBUF=y
BR2_PACKAGE_IPERF3=y
BR2_TARGET_ROOTFS_EXT2=y
BR2_TARGET_ROOTFS_EXT2_4=y
BR2_TARGET_ROOTFS_EXT2_SIZE="700M"
# BR2_TARGET_ROOTFS_TAR is not set
BR2_PACKAGE_HOST_GENIMAGE=y
```

## configs/spacemit_stev10_initramfs_defconfig
```kconfig
BR2_riscv=y
BR2_TOOLCHAIN_EXTERNAL=y
BR2_SYSTEM_DHCP="eth0"
BR2_ROOTFS_POST_IMAGE_SCRIPT="board/qemu/post-image.sh"
BR2_ROOTFS_POST_SCRIPT_ARGS="$(BR2_DEFCONFIG)"
BR2_LINUX_KERNEL=y
BR2_LINUX_KERNEL_CUSTOM_GIT=y
BR2_LINUX_KERNEL_CUSTOM_REPO_URL="ssh://chenlinfei@gerrit.dc.com:29418/linux/linux-6.1"
BR2_LINUX_KERNEL_CUSTOM_REPO_VERSION="k1-dev-stev10"
BR2_LINUX_KERNEL_USE_CUSTOM_CONFIG=y
BR2_LINUX_KERNEL_CUSTOM_CONFIG_FILE="board/spacemit/stev10/linux.config"
BR2_LINUX_KERNEL_DTS_SUPPORT=y
BR2_LINUX_KERNEL_CUSTOM_DTS_PATH="board/spacemit/stev10/stev10.dts board/spacemit/stev10/stev10_1x4.dts board/spacemit/stev10/stev10_2x4.dts"
# BR2_PACKAGE_IFUPDOWN_SCRIPTS is not set
# BR2_PACKAGE_URANDOM_SCRIPTS is not set
BR2_TARGET_ROOTFS_EXT2=y
BR2_TARGET_ROOTFS_INITRAMFS=y
BR2_TARGET_OPENSBI=y
BR2_TARGET_OPENSBI_CUSTOM_GIT=y
BR2_TARGET_OPENSBI_CUSTOM_REPO_URL="ssh://$$USER@gerrit.dc.com:29418/opensbi/opensbi"
BR2_TARGET_OPENSBI_CUSTOM_REPO_VERSION="k1-dev-stev10"
BR2_TARGET_OPENSBI_PLAT="spacemit/k1-pro"
BR2_TARGET_OPENSBI_LINUX_PAYLOAD=y
```

## package/ck/Config.in
```kconfig
config BR2_PACKAGE_CK
    bool "ck"
    help
      Concurrency primitives, safe memory reclamation mechanisms and
      non-blocking (including lock-free) data structures designed to
      aid in the research, design and implementation of high performance
      concurrent systems developed in C99+.

      http://concurrencykit.org/
```

## package/himeno/Config.in
```kconfig
config BR2_PACKAGE_HIMENO
	bool "himeno"
	depends on BR2_PACKAGE_OPENMPI
	help
	  C + MPI, dynamic allocate version

	  https://github.com/calorie/himeno_benchmark
```

## package/python-glslang/Config.in
```kconfig
config BR2_PACKAGE_PYTHON_GLSLANG
	bool "python-glslang"
	depends on BR2_PACKAGE_PYTHON3
	help
	  This package provides the official Python bindings for the
	  glslang library.

	  https://github.com/KhronosGroup/glslang
```

## package/python-glslang/Config.in.host
```kconfig
config BR2_PACKAGE_HOST_PYTHON_GLSLANG
	bool "host python-glslang"
	depends on BR2_PACKAGE_HOST_PYTHON3
        help
          This package provides the official Python bindings for the
          glslang library.

          https://github.com/KhronosGroup/glslang
```
